/*
 * kv260_cnn.dts — device-tree overlay exposing cnn_top's AXI4-Lite slave as a
 * generic-uio device for the cnn_host userspace application.
 *
 * BOARD-ONLY: the `reg` (address) and `interrupts` values must match the block
 * design generated by scripts/board/build_bitstream.tcl. Regenerate after the
 * block design's address editor assigns the cnn_top slave its base address
 * (default 0xA400_0000 in M_AXI_HPM0_FPD) and IRQ line (pl_ps_irq0).
 *
 * Compile (on any machine with dtc):
 *   dtc -I dts -O dtb -o kv260_cnn.dtbo kv260_cnn.dts
 * Load on the KV260 (after the .bit.bin firmware is installed):
 *   xmutil unloadapp   # if a firmware app is loaded
 *   cp kv260_cnn.dtbo /lib/firmware/
 *   xmutil loadapp kv260_cnn
 */

/dts-v1/;
/plugin/;

/ {
    fragment@0 {
        target = <&fpga_full>;
        __overlay__ {
            firmware-name = "cnn_top.bit.bin";
        };
    };

    fragment@1 {
        target-path = "/";
        __overlay__ {
            cnn_accel: cnn_accel@a4000000 {
                compatible = "generic-uio";
                reg = <0x0 0xa4000000 0x0 0x10000>;   /* 64 KB window */
                interrupt-parent = <&gic>;
                interrupts = <0 89 4>;                 /* pl_ps_irq0; adjust */
            };
        };
    };
};
